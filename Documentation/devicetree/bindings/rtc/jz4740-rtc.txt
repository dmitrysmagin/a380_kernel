## Documentation/devicetree/bindings/rtc/jz4740-rtc.txt
```
Ingenic JZ4740 RTC controller

Required properties:
- compatible: "ingenic,jz4740-rtc"
- reg: physical base address of the controller and length of memory mapped
  region.
- interrupts: IRQ line for the controller.
- clocks: Phandle to the parent clock

Example:

	rtc@3000 {
		compatible = "ingenic,jz4740-rtc";
		reg = <0x3000 0x1000>;
		interrupts = <15>;
		clocks = <&rtc_clk>;
	};
```

## Documentation/devicetree/bindings/sound/jz4740-codec.txt
```
Ingenic JZ4740 audio CODEC

Required properties:
	- compatible: Must be "ingenic,jz4740-codec"
	- reg: The CODEC's registers location and length

Example:

	codec: codec@20080 {
		compatible = "ingenic,jz4740-codec";
		reg = <0x20080 0xf7f>;
	};
```

## arch/mips/configs/a320_defconfig
```kconfig
CONFIG_LOCALVERSION="-dingux"
CONFIG_DEFAULT_HOSTNAME="opendingux"
CONFIG_SYSVIPC=y
CONFIG_NO_HZ=y
CONFIG_LOG_BUF_SHIFT=14
CONFIG_BLK_DEV_INITRD=y
CONFIG_INITRAMFS_SOURCE="initrd/tree.txt"
# CONFIG_RD_GZIP is not set
CONFIG_SYSCTL_SYSCALL=y
# CONFIG_KALLSYMS is not set
# CONFIG_ELF_CORE is not set
# CONFIG_BASE_FULL is not set
CONFIG_EMBEDDED=y
# CONFIG_VM_EVENT_COUNTERS is not set
CONFIG_SLAB=y
# CONFIG_BLK_DEV_BSG is not set
# CONFIG_IOSCHED_CFQ is not set
CONFIG_PREEMPT_VOLUNTARY=y
# CONFIG_COMPACTION is not set
# CONFIG_CROSS_MEMORY_ATTACH is not set
CONFIG_CLEANCACHE=y
CONFIG_FRONTSWAP=y
# CONFIG_SECCOMP is not set
CONFIG_CMDLINE_BOOL=y
CONFIG_CMDLINE="panic=5 console=tty0 boot=/dev/mmcblk0,/dev/mmcblk0p1 loop0=/boot/rootfs.bin root=/dev/loop0 fbcon=bind:0"
CONFIG_CPU_FREQ=y
# CONFIG_CPU_FREQ_STAT is not set
CONFIG_CPU_FREQ_DEFAULT_GOV_USERSPACE=y
CONFIG_NET=y
CONFIG_PACKET=y
CONFIG_UNIX=y
CONFIG_INET=y
# CONFIG_INET_XFRM_MODE_TRANSPORT is not set
# CONFIG_INET_XFRM_MODE_TUNNEL is not set
# CONFIG_INET_XFRM_MODE_BEET is not set
# CONFIG_INET_LRO is not set
# CONFIG_INET_DIAG is not set
# CONFIG_IPV6 is not set
# CONFIG_WIRELESS is not set
CONFIG_UEVENT_HELPER_PATH="/sbin/hotplug"
# CONFIG_FW_LOADER is not set
CONFIG_MTD=y
CONFIG_CC_FTL=y
CONFIG_MTD_NAND=y
CONFIG_MTD_UBI=y
CONFIG_BLK_DEV_LOOP=y
CONFIG_NETDEVICES=y
# CONFIG_WLAN is not set
# CONFIG_INPUT_MOUSEDEV_PSAUX is not set
CONFIG_INPUT_MOUSEDEV_SCREEN_X=320
CONFIG_INPUT_MOUSEDEV_SCREEN_Y=240
CONFIG_INPUT_EVDEV=y
# CONFIG_KEYBOARD_ATKBD is not set
CONFIG_KEYBOARD_GPIO=y
# CONFIG_INPUT_MOUSE is not set
CONFIG_INPUT_MISC=y
CONFIG_INPUT_UINPUT=y
# CONFIG_SERIO is not set
CONFIG_VT_HW_CONSOLE_BINDING=y
CONFIG_LEGACY_PTY_COUNT=2
# CONFIG_DEVMEM is not set
# CONFIG_DEVKMEM is not set
CONFIG_SERIAL_8250=y
CONFIG_SERIAL_8250_NR_UARTS=2
CONFIG_SERIAL_8250_RUNTIME_UARTS=2
# CONFIG_HW_RANDOM is not set
CONFIG_I2C=y
# CONFIG_I2C_COMPAT is not set
CONFIG_I2C_CHARDEV=y
CONFIG_I2C_GPIO=y
CONFIG_GPIOLIB=y
CONFIG_CHARGER_GPIO=y
# CONFIG_HWMON is not set
CONFIG_WATCHDOG=y
CONFIG_WATCHDOG_CORE=y
CONFIG_MEDIA_SUPPORT=y
CONFIG_MEDIA_RADIO_SUPPORT=y
CONFIG_RADIO_RDA5807=y
# CONFIG_MEDIA_TUNER_SIMPLE is not set
# CONFIG_MEDIA_TUNER_TDA8290 is not set
# CONFIG_MEDIA_TUNER_TDA827X is not set
# CONFIG_MEDIA_TUNER_TDA18271 is not set
# CONFIG_MEDIA_TUNER_TDA9887 is not set
# CONFIG_MEDIA_TUNER_TEA5761 is not set
# CONFIG_MEDIA_TUNER_TEA5767 is not set
# CONFIG_MEDIA_TUNER_MT20XX is not set
# CONFIG_MEDIA_TUNER_MT2060 is not set
# CONFIG_MEDIA_TUNER_MT2266 is not set
# CONFIG_MEDIA_TUNER_MT2131 is not set
# CONFIG_MEDIA_TUNER_QT1010 is not set
# CONFIG_MEDIA_TUNER_XC2028 is not set
# CONFIG_MEDIA_TUNER_XC5000 is not set
# CONFIG_MEDIA_TUNER_MXL5005S is not set
# CONFIG_MEDIA_TUNER_MXL5007T is not set
# CONFIG_MEDIA_TUNER_MC44S803 is not set
# CONFIG_MEDIA_TUNER_MAX2165 is not set
# CONFIG_MEDIA_TUNER_TDA18218 is not set
# CONFIG_MEDIA_TUNER_TDA18212 is not set
CONFIG_FB=y
CONFIG_BACKLIGHT_LCD_SUPPORT=y
CONFIG_LCD_PLATFORM=y
# CONFIG_BACKLIGHT_GENERIC is not set
CONFIG_BACKLIGHT_PWM=y
# CONFIG_VGA_CONSOLE is not set
CONFIG_FRAMEBUFFER_CONSOLE=y
CONFIG_FONTS=y
CONFIG_FONT_6x10=y
CONFIG_LOGO=y
# CONFIG_LOGO_LINUX_MONO is not set
# CONFIG_LOGO_LINUX_VGA16 is not set
# CONFIG_LOGO_LINUX_CLUT224 is not set
CONFIG_SOUND=y
CONFIG_SND=y
# CONFIG_SND_SUPPORT_OLD_API is not set
# CONFIG_SND_VERBOSE_PROCFS is not set
# CONFIG_SND_DRIVERS is not set
CONFIG_SND_SOC=y
CONFIG_USB_GADGET=y
CONFIG_USB_GADGET_VBUS_DRAW=500
CONFIG_USB_ETH=y
CONFIG_MMC=y
CONFIG_MMC_UNSAFE_RESUME=y
# CONFIG_MMC_BLOCK_BOUNCE is not set
CONFIG_RTC_CLASS=y
# CONFIG_RTC_INTF_PROC is not set
# CONFIG_RTC_DRV_CMOS is not set
CONFIG_STAGING=y
CONFIG_ZRAM=y
CONFIG_ZSMALLOC=y
CONFIG_PWM=y
# CONFIG_FIRMWARE_MEMMAP is not set
# CONFIG_DNOTIFY is not set
# CONFIG_INOTIFY_USER is not set
CONFIG_VFAT_FS=y
CONFIG_PROC_KCORE=y
CONFIG_TMPFS=y
CONFIG_UBIFS_FS=y
CONFIG_UBIFS_FS_ADVANCED_COMPR=y
# CONFIG_UBIFS_FS_LZO is not set
# CONFIG_UBIFS_FS_ZLIB is not set
CONFIG_SQUASHFS=y
# CONFIG_NETWORK_FILESYSTEMS is not set
CONFIG_NLS_CODEPAGE_437=y
CONFIG_NLS_CODEPAGE_936=y
CONFIG_NLS_ASCII=y
CONFIG_NLS_ISO8859_1=y
CONFIG_FRAME_WARN=1024
# CONFIG_UNUSED_SYMBOLS is not set
# CONFIG_FTRACE is not set
# CONFIG_EARLY_PRINTK is not set
# CONFIG_CRYPTO_ANSI_CPRNG is not set
# CONFIG_CRYPTO_HW is not set
```

## arch/mips/jz4740/Kconfig
```kconfig
choice
	prompt "Machine type"
	depends on MACH_JZ4740
	default JZ4740_QI_LB60

config JZ4740_QI_LB60
	bool "Qi Hardware Ben NanoNote"

config JZ4740_A320
	bool "Dingoo A320 game and media player"

endchoice
```

## arch/mips/jz4750d/Kconfig
```kconfig
choice
	prompt "Machine type"
	depends on MACH_JZ4750D
	default JZ4750D_RZX50

config JZ4750D_RZX50
	bool "Ritmix RZX50 game handheld"

config JZ4750D_A380
	bool "Dingoo A380 game handheld"

config JZ4750D_A320E
	bool "Dingoo A320E game handheld"

endchoice
```

## drivers/char/jzchar/Kconfig
```kconfig
#
# JzSOC char devices configuration
#

menu "JZSOC char device support"
	depends on SOC_JZ4740 || SOC_JZ4730 || SOC_JZ4750 || SOC_JZ4750D

config JZCHAR
	tristate 'JzSOC char device support'

config JZ_SADC
	tristate 'JZ SADC driver support'
	depends on JZCHAR

config JZ_UDC_HOTPLUG
	tristate 'JZ UDC hotplug driver support'
	depends on JZCHAR

config JZ_GSENSOR
	tristate 'JZ G-sensor driver support'
	depends on JZCHAR

config JZ_RADIO_RDA5807P
	tristate 'JZ Radio rda5807p driver support'
	depends on JZCHAR

config JZ_A380_ELAN
	tristate 'JZ Dingoo A380 wireless driver support'
	depends on JZCHAR

config JZ_POWEROFF
	tristate 'JZ board poweroff support'
	depends on JZCHAR

config JZ_TCSM
	tristate 'JZ TCSM support'
	depends on JZCHAR

endmenu
```

## sound/soc/jz4750/Kconfig
```kconfig
config SND_JZ4750_SOC
	tristate "SoC Audio for Ingenic jz4750 chip"
	depends on SND_SOC && MACH_JZ4750D
	help
	  Say Y or M if you want to add support for codecs attached to
	  the Jz4750 AC97, I2S or SSP interface. You will also need
	  to select the audio interfaces to support below.

config SND_JZ4750_SOC_I2S
	depends on SND_JZ4750_SOC
	tristate "SoC Audio (I2S protocol) for Ingenic jz4750 chip"
	help
	  Say Y if you want to use I2S protocol and I2S codec on Ingenic Jz4750.

config SND_JZ4750_SOC_A380
	tristate "SoC Audio support for Dingoo A380"
	depends on SND_JZ4750_SOC && JZ4750D_A380
	help
	  Say Y if you want to add support for SoC audio of internal codec
	  on Dingoo A380.

config SND_JZ4750_SOC_RZX50
	tristate "SoC Audio support for Ritmix RZX-50"
	depends on SND_JZ4750_SOC && JZ4750D_RZX50
	help
	  Say Y if you want to add support for SoC audio of internal codec
	  on Ritmix RZX-50.
```
